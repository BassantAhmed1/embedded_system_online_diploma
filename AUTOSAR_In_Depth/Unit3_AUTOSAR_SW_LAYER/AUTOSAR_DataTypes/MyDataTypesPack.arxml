AUTOSAR XML (schema 00046)
standard types defined: uint8
package /MyDataTypesPack
  physical dimension Distance_in_meters: length-exp=1
  unit Meters: factor-si-to-unit=1, physical-dimension=Distance_in_meters
  compu method cm_meters: identical; unit Meters
  app type My_Meters_Type: category=Value, compu-method=cm_meters
  application array data type MyMetersArrayType: category=ARRAY
    element Elements: category=VALUE, type=My_Meters_Type, array-size-semantics=FIXED-SIZE, max-number-of-elements=4
  application record data type MyPointType: category=STRUCTURE
    application record element X: category=VALUE, type=My_Meters_Type
    application record element Y: category=VALUE, type=My_Meters_Type
  base type My_sint8: base-type-size=8, base-type-encoding=2C, mem-alignment=1, native-declaration=char
  base type My_uint8: base-type-size=8, base-type-encoding=NONE, mem-alignment=1, native-declaration=unsigned char
  range DC_uint8: phys 0..255, raw 0..255
  data type mapping set DataType_Mapping: data-type-map{application-data-type=My_Meters_Type, implementation-data-type=uint8}
