AUTOSAR XML (schema 00046)
package /SR_InterfaceLab
  sender receiver interface Interface1
    data Lidar_ObjectDistance: type=uint32
  sensor actuator sw component type SWC1
    provide port P_Port1: provided-interface=Interface1
  application sw component type SWC2
    require port R_Port1: required-interface=Interface1
